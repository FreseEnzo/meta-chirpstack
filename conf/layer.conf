## conf/layer.conf
```bitbake
# Layer configuration for the meta-chirpstack Yocto layer.
# Adjust the priority and compatibility lines to your needs.

BBPATH .= ":${LAYERDIR}"
BBFILES += "${LAYERDIR}/recipes-*/*/*.bb \
            ${LAYERDIR}/recipes-*/*/*.bbappend"

BBFILE_COLLECTIONS += "chirpstack"
BBFILE_PATTERN_chirpstack = "^${LAYERDIR}/"
BBFILE_PRIORITY_chirpstack = "6"

# (Optional) If you want to specify which Yocto release branches
# this layer is compatible with. For example:
LAYERSERIES_COMPAT_chirpstack = "dunfell kirkstone langdale mickledore"
```
